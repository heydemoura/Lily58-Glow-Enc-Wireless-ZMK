## config/west.yml
```yaml
manifest:
  remotes:
    - name: zmkfirmware
      url-base: https://github.com/zmkfirmware
    - name: infused-kim
      url-base: https://github.com/infused-kim
  projects:
    - name: zmk
      remote: zmkfirmware
      revision: main
    - name: zmk-zephyr
      remote: infused-kim
      revision: v3.0.0+zmk-fixes+pd-oled
      clone-depth: 1
  self:
    path: config
```
